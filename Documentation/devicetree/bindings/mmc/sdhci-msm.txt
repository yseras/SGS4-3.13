## Documentation/devicetree/bindings/mmc/sdhci-msm.txt
```
* Qualcomm SDHCI controller (sdhci-msm)

This file documents differences between the core properties in mmc.txt
and the properties used by the sdhci-msm driver.

Required properties:
- compatible: Should contain "qcom,sdhci-msm".
- reg: Base address and length of the register set listed in reg-names.
- reg-names: Should contain the following:
	"hc_mem"   - Host controller register map
	"core_mem" - SD Core register map
- interrupts: Should contain an interrupt-specifiers for the interrupts listed in interrupt-names.
- interrupt-names: Should contain the following:
	"hc_irq"     - Host controller interrupt
	"pwr_irq"    - PMIC interrupt
- vdd-supply: Phandle to the regulator for the vdd (core voltage) supply.
- vdd-io-supply: Phandle to the regulator for the vdd-io (i/o voltage) supply.
- pinctrl-names: Should contain only one value - "default".
- pinctrl-0: Should specify pin control groups used for this controller.
- clocks: A list of phandle + clock-specifier pairs for the clocks listed in clock-names.
- clock-names: Should contain the following:
	"iface" - Main peripheral bus clock (PCLK/HCLK - AHB Bus clock) (required)
	"core"	- SDC MMC clock (MCLK) (required)
	"bus"	- SDCC bus voter clock (optional)

Optional properties:

- qcom,vdd-voltage-min - Specifies the minimum core voltage supported by the device in microvolts.
- qcom,vdd-voltage-max - Specifies the maximum core voltage supported by the device in microvolts.
- qcom,vdd-io-voltage-min - Specifies the minimum i/o voltage supported by the device in microvolts.
- qcom,vdd-io-voltage-max - Specifies the maximum i/o voltage supported by the device in microvolts.

Example:

	sdhc_1: sdhci@f9824900 {
		compatible = "qcom,sdhci-msm";
		reg = <0xf9824900 0x11c>, <0xf9824000 0x800>;
		reg-names = "hc_mem", "core_mem";
		interrupts = <0 123 0>, <0 138 0>;
		interrupt-names = "hc_irq", "pwr_irq";
		bus-width = <8>;
		non-removable;

		vdd-supply = <&pm8941_l20>;
		vdd-io-supply = <&pm8941_s3>;

		qcom,vdd-voltage-min = <2950000>;
		qcom,vdd-voltage-max = <2950000>;
		qcom,vdd-io-voltage-min = <1800000>;
		qcom,vdd-io-voltage-max = <1800000>;

		pinctrl-names = "default";
		pinctrl-0 = <&sdc1_clk &sdc1_cmd &sdc1_data>;

		clocks = <&gcc GCC_SDCC1_APPS_CLK>, <&gcc GCC_SDCC1_AHB_CLK>;
		clock-names = "core", "iface";
	};

	sdhc_2: sdhci@f98a4900 {
		compatible = "qcom,sdhci-msm";
		reg = <0xf98a4900 0x11c>, <0xf98a4000 0x800>;
		reg-names = "hc_mem", "core_mem";
		interrupts = <0 1 2>;
		#interrupt-cells = <1>;
		interrupt-map = <0 &intc 0 125 0
			1 &intc 0 221 0>;
		interrupt-names = "hc_irq", "pwr_irq";
		bus-width = <4>;

		vdd-supply = <&pm8941_l21>;
		vdd-io-supply = <&pm8941_l13>;

		qcom,vdd-voltage-min = <2950000>;
		qcom,vdd-voltage-max = <2950000>;
		qcom,vdd-io-voltage-min = <1800000>;
		qcom,vdd-io-voltage-max = <2950000>;

		pinctrl-names = "default";
		pinctrl-0 = <&sdc2_clk &sdc2_cmd &sdc2_data>;

		clocks = <&gcc GCC_SDCC2_APPS_CLK>, <&gcc GCC_SDCC2_AHB_CLK>;
		clock-names = "core", "iface";
	};
```

## arch/arm/mach-msm/Kconfig
```kconfig
if ARCH_MSM

menu "MSM SoC Type"

config ARCH_APQ8064
	bool "APQ8064"
	select ARCH_MSM_KRAITMP
	select ARCH_HAS_CPUFREQ
	select GPIO_MSM_V2
	select ARM_GIC
	select CPU_V7
	select MSM_SCM if SMP
	select MSM_GPIOMUX
	select MSM_REMOTE_SPINLOCK_SFPB
	select MSM_PIL
	select MSM_QDSP6_APR
	select MSM_QDSP6_CODECS
	select MSM_AUDIO_QDSP6 if SND_SOC
	select MULTI_IRQ_HANDLER
	select MSM_RPM
	select MSM_NATIVE_RESTART
	select MSM_PM if PM
	select MSM_SPM_V2
	select MSM_L2_SPM
	select MSM_RPM_SMD
	select MSM_PM8X60 if PM
	select CPU_FREQ_MSM
	select CPU_FREQ
	select PM_DEVFREQ
	select CPU_HAS_L2_PMU
	select HOLES_IN_ZONE if SPARSEMEM
	select CLEANCACHE
	select MIGHT_HAVE_PCI
	select ARCH_SUPPORTS_MSI
	select ARM_HAS_SG_CHAIN
	select MSM_KRAIT_WFE_FIXUP
	select SPARSEMEM_ALLOC_MEM_MAP_TOGETHER if SPARSEMEM
	select MSM_IOMMU_GPU_SYNC
	select MSM_CPU_PWRCTL
	select MSM_SMD
	select MSM_BUS_SCALING

config ARCH_MSM7X00A
	bool "MSM7x00A / MSM7x01A"
	select ARCH_MSM_ARM11
	select CPU_V6
	select GPIO_MSM_V1
	select MACH_TROUT if !MACH_HALIBUT
	select MSM_PROC_COMM
	select MSM_SMD
	select MSM_SMD_PKG3

config ARCH_MSM7X30
	bool "MSM7x30"
	select ARCH_MSM_SCORPION
	select CPU_V7
	select GPIO_MSM_V1
	select MACH_MSM7X30_SURF # if !
	select MSM_GPIOMUX
	select MSM_PROC_COMM
	select MSM_SMD
	select MSM_VIC

config ARCH_QSD8X50
	bool "QSD8X50"
	select ARCH_MSM_SCORPION
	select CPU_V7
	select GPIO_MSM_V1
	select MACH_QSD8X50_SURF if !MACH_QSD8X50A_ST1_5
	select MSM_GPIOMUX
	select MSM_PROC_COMM
	select MSM_SMD
	select MSM_VIC

config ARCH_MSM8X60
	bool "MSM8X60"
	select ARM_GIC
	select CPU_V7
	select GPIO_MSM_V2
	select HAVE_SMP
	select MSM_SCM if SMP

config ARCH_MSM8960
	bool "MSM8960"
	select ARM_GIC
	select CPU_V7
	select HAVE_SMP
	select GPIO_MSM_V2
	select MSM_SCM if SMP
	select MSM_SMD
	select SOC_BUS
	select MSM_PM if PM
	select MEMORY_HOLE_CARVEOUT

endmenu

config  ARCH_MSM_KRAIT
	bool
	select ARM_L1_CACHE_SHIFT_6
	select DEVFREQ_GOV_MSM_CPUBW_HWMON

config  ARCH_MSM_KRAITMP
	select ARCH_MSM_KRAIT
	select HAVE_SMP
	select HAVE_ARCH_HAS_CURRENT_TIMER
	select MSM_JTAG if CORESIGHT_ETM
	bool

config ARCH_MSM_DT
	bool
	depends on (ARCH_MSM8X60 || ARCH_MSM8960)
	select SPARSE_IRQ
	select USE_OF

config MSM_HAS_DEBUG_UART_HS
	bool

config MSM_SOC_REV_A
	bool

config MSM_RPM_SMD
	depends on MSM_SMD
	select MSM_MPM_OF
	bool "RPM driver using SMD protocol"
	help
	  RPM is the dedicated hardware engine for managing shared SoC
	  resources. This config adds driver support for using SMD as a
	  transport layer communication with RPM hardware. It also selects
	  the MSM_MPM config that programs the MPM module to monitor interrupts
	  during sleep modes.

config  ARCH_MSM_ARM11
	bool

config  ARCH_MSM_SCORPION
	bool

config  MSM_VIC
	bool

config MSM_MPM
	bool "Modem Power Manager"
	help
	  MPM is a dedicated hardware resource responsible for entering and
	  waking up from a system wide low power mode. The MPM driver tracks
	  the wakeup interrupts and configures the MPM to monitor the wakeup
	  interrupts when going to a system wide sleep mode.

menu "Qualcomm MSM Board Type"
	depends on !ARCH_MSM_DT

config MACH_JF
	depends on ARCH_APQ8064
	default n
	select SND_SOC_WCD9310
	bool "APQ8064 Samsung JF"
	help
	  This is JF device of Samsung.
	  It's based on Qualcomm APQ8064 chipset.

config MACH_JF_TMO
	depends on ARCH_APQ8064
	default n
	select SND_SOC_WCD9310
	bool "APQ8064 Samsung JF_TMO"
	help
	  Support for the Samsung JF device.

config MACH_HALIBUT
	depends on ARCH_MSM
	depends on ARCH_MSM7X00A
	bool "Halibut Board (QCT SURF7201A)"
	help
	  Support for the Qualcomm SURF7201A eval board.

config MACH_TROUT
	depends on ARCH_MSM
	depends on ARCH_MSM7X00A
	bool "HTC Dream (aka trout)"
	help
	  Support for the HTC Dream, T-Mobile G1, Android ADP1 devices.

config MACH_MSM7X30_SURF
	depends on ARCH_MSM7X30
	bool "MSM7x30 SURF"
	help
	  Support for the Qualcomm MSM7x30 SURF eval board.

config MACH_QSD8X50_SURF
	depends on ARCH_QSD8X50
	bool "QSD8x50 SURF"
	help
	  Support for the Qualcomm QSD8x50 SURF eval board.

config MACH_QSD8X50A_ST1_5
	depends on ARCH_QSD8X50
	bool "QSD8x50A ST1.5"
	select MSM_SOC_REV_A
	help
	  Support for the Qualcomm ST1.5.

endmenu

if CPU_FREQ_MSM

config MSM_CPU_FREQ_SET_MIN_MAX
	bool "Set Min/Max CPU frequencies."
	default n
	help
	  Allow setting min and max CPU frequencies. Sysfs can be used
	  to override these values.

config MSM_CPU_FREQ_MAX
	int "Max CPU Frequency"
	depends on MSM_CPU_FREQ_SET_MIN_MAX
	default 384000

config MSM_CPU_FREQ_MIN
	int "Min CPU Frequency"
	depends on MSM_CPU_FREQ_SET_MIN_MAX
	default 245760

endif # CPU_FREQ_MSM

config MSM_SMD_PKG3
	bool

config MSM_PROC_COMM
	bool

config MSM_SMD
	depends on MSM_SMEM
	bool "MSM Shared Memory Driver (SMD)"
	help
	  Support for the shared memory interface between the apps
	  processor and the baseband processor.  Provides access to
	  the "shared heap", as well as virtual serial channels
	  used to communicate with various services on the baseband
	  processor.

config MSM_HSIC_GPIO_REV06
	bool "distinguish rev03 and rev06"
	default n

config MSM_NATIVE_RESTART
	bool

config MSM_PM
	depends on PM
	bool

config MSM_BUS_SCALING
	bool "Bus scaling driver"
	default n

config MSM_GPIOMUX
	bool
	depends on !ARCH_MSM_DT
	help
	  Support for MSM V1 TLMM GPIOMUX architecture.

config MSM_SHOW_RESUME_IRQ
	bool "Enable logging of interrupts that could have caused resume"
	depends on (ARM_GIC || PMIC8058)
	default y if PMIC8058
	default n
	help
		This option logs wake up interrupts that have triggered just before
		the resume loop unrolls. Say Y if you want to debug why the system
		resumed.

config MSM_QDSP6_APR
	bool "Audio QDSP6 APR support"
	depends on MSM_SMD
	default n
	help
	  Enable APR IPC protocol support between
	  application processor and QDSP6. APR is
	  used by audio driver to configure QDSP6's
	  ASM, ADM and AFE.

config MSM_QDSP6_CODECS
	bool "Audio Codecs on QDSP6 APR "
	depends on MSM_SMD
	default n
	help
	  Enable Audio codecs with APR IPC protocol support between
	  application processor and QDSP6. APR is
	  used by audio driver to configure QDSP6's
	  ASM, ADM and AFE.


config MSM_SPM_V2
	bool "Driver support for SPM Version 2"
	help
	  Enables the support for Version 2 of the SPM driver. SPM hardware is
	  used to manage the processor power during sleep. The driver allows
	  configuring SPM to allow different power modes.

config MSM_L2_SPM
	bool "SPM support for L2 cache"
	depends on MSM_SPM_V2
	help
	  Enable SPM driver support for L2 cache. Some MSM chipsets allow
	  control of L2 cache low power mode with a Subsystem Power manager.
	  Enabling this driver allows configuring L2 SPM for low power modes
	  on supported chipsets.

config MSM_SCM
	bool

config SEC_THERMISTOR
	bool "Use external thermistor near AP for checking temprature"
	default n
	help
	Use thermistor driver for checking temperature near AP chip.

endif
```
